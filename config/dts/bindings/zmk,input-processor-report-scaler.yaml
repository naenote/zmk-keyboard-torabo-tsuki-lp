## config/dts/bindings/zmk,input-processor-report-scaler.yaml
```yaml
description: Input processor report scaler
compatible: "zmk,input-processor-report-scaler"
properties:
  "#input-processor-cells":
    type: int
    const: 2
```
